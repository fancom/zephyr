## CMakeLists.txt
```
cmake_minimum_required(VERSION 3.13.1)
# Top-level CMakeLists.txt for the skeleton application.
#
# Copyright (c) 2017 Open Source Foundries Limited
#
# SPDX-License-Identifier: Apache-2.0
#
# This provides a basic application structure suitable for communication using
# mcumgr.  It can be used as a starting point for new applications.

# Standard Zephyr application boilerplate.
find_package(Zephyr REQUIRED HINTS $ENV{ZEPHYR_BASE})
project(smp_svr)

zephyr_compile_definitions(CBOR_NO_FLOATING_POINT=1 CBOR_NO_HALF_FLOAT_TYPE=1)

target_sources(app PRIVATE src/main.c)
target_sources_ifdef(CONFIG_MCUMGR_SMP_BT app PRIVATE src/bluetooth.c)
target_sources_ifdef(CONFIG_MCUMGR_SMP_UDP app PRIVATE src/udp.c)
```

## prj.conf
```kconfig
# Enable mcumgr.
CONFIG_MCUMGR=y

# Some command handlers require a large stack.
CONFIG_SYSTEM_WORKQUEUE_STACK_SIZE=2048

# Ensure an MCUboot-compatible binary is generated.
CONFIG_BOOTLOADER_MCUBOOT=y

# Enable flash operations.
CONFIG_FLASH=y
#CONFIG_FLASH_LOG_LEVEL_DBG=y

# Required by the `taskstat` command.
CONFIG_THREAD_MONITOR=y

# Enable statistics and statistic names.
CONFIG_STATS=y
CONFIG_STATS_NAMES=y

# Enable most core commands.
CONFIG_MCUMGR_CMD_IMG_MGMT=y
CONFIG_MCUMGR_CMD_OS_MGMT=y
CONFIG_MCUMGR_CMD_STAT_MGMT=y

# Enable logging
CONFIG_LOG=y
#CONFIG_MCUBOOT_UTIL_LOG_LEVEL_WRN=y
#CONFIG_LOG_DEFAULT_LEVEL=4
#CONFIG_MCUBOOT_UTIL_LOG_LEVEL_INF=y
CONFIG_LOG_MODE_DEFERRED=n
CONFIG_LOG_MODE_IMMEDIATE=y

# Peripherals
CONFIG_GPIO=y
CONFIG_GPIO_STM32=y
CONFIG_PINMUX_STM32=y

# Master Clock Out (MCO1) 25MHz (for KSZ8895)
CONFIG_CLOCK_STM32_MCO1_SRC_HSE=y
CONFIG_CLOCK_STM32_MCO1_SRC_NOCLOCK=n
CONFIG_CLOCK_STM32_MCO1_DIV=1
CONFIG_SPI=y

CONFIG_SYSTEM_WORKQUEUE_STACK_SIZE=4096

CONFIG_THREAD_ANALYZER=y
CONFIG_THREAD_ANALYZER_USE_PRINTK=y
CONFIG_THREAD_ANALYZER_AUTO=y
CONFIG_THREAD_NAME=y

#Disable HW RNG
CONFIG_TEST_RANDOM_GENERATOR=y
CONFIG_ENTROPY_STM32_RNG=n
```

## overlay-udp.conf
```kconfig
# Enable the UDP mcumgr transports.
CONFIG_MCUMGR_SMP_UDP=y
CONFIG_MCUMGR_SMP_UDP_IPV4=y
CONFIG_MCUMGR_SMP_UDP_IPV6=n

# Network settings
CONFIG_NETWORKING=y
CONFIG_NET_UDP=y
CONFIG_NET_IPV4=y
CONFIG_NET_IPV6=n
CONFIG_NET_SOCKETS=y
CONFIG_NET_SOCKETS_POSIX_NAMES=y
CONFIG_NET_CONNECTION_MANAGER=y
CONFIG_NET_BUF_USER_DATA_SIZE=24
CONFIG_NET_CONFIG_SETTINGS=y
CONFIG_NET_CONFIG_MY_IPV4_ADDR="192.168.138.2"
CONFIG_NET_CONFIG_MY_IPV4_GW="192.168.138.1"
#CONFIG_NET_CONFIG_MY_IPV6_ADDR="2001:db8::1"

CONFIG_ETH_STM32_HAL_RANDOM_MAC=n
CONFIG_ETH_STM32_HAL_MAC3=0x33
CONFIG_ETH_STM32_HAL_MAC4=0x44
CONFIG_ETH_STM32_HAL_MAC5=0x55

# Network shell
CONFIG_NET_SHELL=y
CONFIG_SHELL=y
CONFIG_SHELL_MINIMAL=y

# Logging
CONFIG_NET_LOG=y
CONFIG_PRINTK=y

CONFIG_MCUMGR_SMP_UDP_STACK_SIZE=4096
```

## src/main.c
```c
/*
 * Copyright (c) 2012-2014 Wind River Systems, Inc.
 * Copyright (c) 2020 Prevas A/S
 *
 * SPDX-License-Identifier: Apache-2.0
 */

#include <zephyr.h>
#include <stats/stats.h>
#include <usb/usb_device.h>

#ifdef CONFIG_MCUMGR_CMD_FS_MGMT
#include <device.h>
#include <fs/fs.h>
#include "fs_mgmt/fs_mgmt.h"
#include <fs/littlefs.h>
#endif
#ifdef CONFIG_MCUMGR_CMD_OS_MGMT
#include "os_mgmt/os_mgmt.h"
#endif
#ifdef CONFIG_MCUMGR_CMD_IMG_MGMT
#include "img_mgmt/img_mgmt.h"
#endif
#ifdef CONFIG_MCUMGR_CMD_STAT_MGMT
#include "stat_mgmt/stat_mgmt.h"
#endif
#ifdef CONFIG_MCUMGR_CMD_SHELL_MGMT
#include "shell_mgmt/shell_mgmt.h"
#endif
#ifdef CONFIG_MCUMGR_CMD_FS_MGMT
#include "fs_mgmt/fs_mgmt.h"
#endif

#define LOG_LEVEL LOG_LEVEL_DBG
#include <logging/log.h>
LOG_MODULE_REGISTER(smp_sample);

#include "common.h"
#include "drivers/gpio.h"
#include "debug/thread_analyzer.h"

/* Define an example stats group; approximates seconds since boot. */
STATS_SECT_START(smp_svr_stats)
STATS_SECT_ENTRY(ticks)
STATS_SECT_END;

/* Assign a name to the `ticks` stat. */
STATS_NAME_START(smp_svr_stats)
STATS_NAME(smp_svr_stats, ticks)
STATS_NAME_END(smp_svr_stats);

/* Define an instance of the stats group. */
STATS_SECT_DECL(smp_svr_stats) smp_svr_stats;

#ifdef CONFIG_MCUMGR_CMD_FS_MGMT
FS_LITTLEFS_DECLARE_DEFAULT_CONFIG(cstorage);
static struct fs_mount_t littlefs_mnt = {
	.type = FS_LITTLEFS,
	.fs_data = &cstorage,
	.storage_dev = (void *)FLASH_AREA_ID(storage),
	.mnt_point = "/lfs1"
};
#endif

void main(void)
{
	int gpio_rc = gpio_pin_configure(
		device_get_binding(DT_GPIO_LABEL(DT_ALIAS(ethsw_reset_gpio), gpios)),
		DT_GPIO_PIN(DT_ALIAS(ethsw_reset_gpio), gpios),
		GPIO_OUTPUT_INACTIVE | DT_GPIO_FLAGS(DT_ALIAS(ethsw_reset_gpio), gpios));
	LOG_INF("gpio_pin_configure %d", gpio_rc);
	assert(gpio_rc == 0);
	gpio_rc = gpio_pin_set(
		device_get_binding(DT_GPIO_LABEL(DT_ALIAS(ethsw_reset_gpio), gpios)),
		DT_GPIO_PIN(DT_ALIAS(ethsw_reset_gpio), gpios), true);
	LOG_INF("gpio_pin_set %d", gpio_rc);
	assert(gpio_rc == 0);
    k_sleep(K_MSEC(100));
	gpio_rc = gpio_pin_set(
		device_get_binding(DT_GPIO_LABEL(DT_ALIAS(ethsw_reset_gpio), gpios)),
		DT_GPIO_PIN(DT_ALIAS(ethsw_reset_gpio), gpios), false);
	LOG_INF("gpio_pin_set %d", gpio_rc);
	assert(gpio_rc == 0);
    k_sleep(K_MSEC(500));

	LOG_INF("Hello example 1");
	int rc = STATS_INIT_AND_REG(smp_svr_stats, STATS_SIZE_32,
				    "smp_svr_stats");

	if (rc < 0) {
		LOG_ERR("Error initializing stats system [%d]", rc);
	}

	/* Register the built-in mcumgr command handlers. */
#ifdef CONFIG_MCUMGR_CMD_FS_MGMT
	rc = fs_mount(&littlefs_mnt);
	if (rc < 0) {
		LOG_ERR("Error mounting littlefs [%d]", rc);
	}

	fs_mgmt_register_group();
#endif
#ifdef CONFIG_MCUMGR_CMD_OS_MGMT
	os_mgmt_register_group();
#endif
#ifdef CONFIG_MCUMGR_CMD_IMG_MGMT
	img_mgmt_register_group();
#endif
#ifdef CONFIG_MCUMGR_CMD_STAT_MGMT
	stat_mgmt_register_group();
#endif
#ifdef CONFIG_MCUMGR_CMD_SHELL_MGMT
	shell_mgmt_register_group();
#endif
#ifdef CONFIG_MCUMGR_CMD_FS_MGMT
	fs_mgmt_register_group();
#endif
#ifdef CONFIG_MCUMGR_SMP_BT
	start_smp_bluetooth();
#endif
#ifdef CONFIG_MCUMGR_SMP_UDP
	start_smp_udp();
#endif

	if (IS_ENABLED(CONFIG_USB)) {
		rc = usb_enable(NULL);
		if (rc) {
			LOG_ERR("Failed to enable USB");
			return;
		}
	}
	/* using __TIME__ ensure that a new binary will be built on every
	 * compile which is convient when testing firmware upgrade.
	 */
	LOG_INF("build time: " __DATE__ " " __TIME__);

	/* The system work queue handles all incoming mcumgr requests.  Let the
	 * main thread idle while the mcumgr server runs.
	 */
	while (1) {
		k_sleep(K_MSEC(1000));
		STATS_INC(smp_svr_stats, ticks);
	}
}
```
