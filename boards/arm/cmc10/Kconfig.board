## boards/arm/cmc10/Kconfig.defconfig
```kconfig
if BOARD_CMC10

config BOARD
	default "cmc10"

if NETWORKING

config NET_L2_ETHERNET
	default y

endif # NETWORKING

endif # BOARD_CMC10
```

## boards/arm/cmc10/cmc10_defconfig
```kconfig
CONFIG_SOC_SERIES_STM32H7X=y
CONFIG_SOC_STM32H743XX=y

# Clock Configuration
CONFIG_CLOCK_CONTROL=y

CONFIG_MAIN_STACK_SIZE=65536
CONFIG_PRIVILEGED_STACK_SIZE=4096
CONFIG_IDLE_STACK_SIZE=512
CONFIG_HEAP_MEM_POOL_SIZE=10240
CONFIG_SYSTEM_WORKQUEUE_STACK_SIZE=10240
```

## boards/arm/cmc10_h723zg/Kconfig.board
```kconfig
config BOARD_CMC10_H723ZG
	bool "CMC10 Process Controller"
	depends on SOC_STM32H723XX
```

## boards/arm/cmc10_h723zg/Kconfig.defconfig
```kconfig
if BOARD_CMC10_H723ZG

config BOARD
	default "cmc10_h723zg"

if NETWORKING

config NET_L2_ETHERNET
	default y

endif # NETWORKING

endif # BOARD_CMC10_H723ZG
```

## boards/arm/cmc10_h723zg/cmc10_h723zg_defconfig
```kconfig
# SPDX-License-Identifier: Apache-2.0

CONFIG_SOC_SERIES_STM32H7X=y
CONFIG_SOC_STM32H723XX=y

# Enable MPU
CONFIG_ARM_MPU=y

# Enable HW stack protection
CONFIG_HW_STACK_PROTECTION=y

# Enable UART
CONFIG_SERIAL=y

# Console
CONFIG_CONSOLE=y
CONFIG_UART_CONSOLE=y

# Enable Pinmux
CONFIG_PINMUX=y
CONFIG_GPIO=y

# Clock Configuration
CONFIG_SYS_CLOCK_HW_CYCLES_PER_SEC=550000000
CONFIG_CLOCK_CONTROL=y
# Use HSE as PLL input
CONFIG_CLOCK_STM32_HSE_CLOCK=25000000
CONFIG_CLOCK_STM32_PLL_SRC_HSE=y
CONFIG_CLOCK_STM32_SYSCLK_SRC_PLL=y
# Configure PLL
CONFIG_CLOCK_STM32_PLL_M_DIVISOR=2
CONFIG_CLOCK_STM32_PLL_N_MULTIPLIER=44
CONFIG_CLOCK_STM32_PLL_P_DIVISOR=1
CONFIG_CLOCK_STM32_PLL_Q_DIVISOR=2
CONFIG_CLOCK_STM32_PLL_R_DIVISOR=2
# Configure System Clocks
CONFIG_CLOCK_STM32_D1CPRE=1
# HCLK: 275MHz
CONFIG_CLOCK_STM32_HPRE=2
# APB1: 137.5MHz
CONFIG_CLOCK_STM32_D2PPRE1=2
# APB2: 137.5MHz
CONFIG_CLOCK_STM32_D2PPRE2=2
# APB3: 137.5MHz
CONFIG_CLOCK_STM32_D1PPRE=2
# APB4: 137.5MHz
CONFIG_CLOCK_STM32_D3PPRE=2

CONFIG_FLASH_ALIGNMENT_WORD_SIZE_BYTES=32
```

## boards/arm/nucleo_h743zi/Kconfig.defconfig
```kconfig
# STM32H743ZI Nucleo board configuration

# Copyright (c) 2020 Teslabs Engineering S.L.
# SPDX-License-Identifier: Apache-2.0

if BOARD_NUCLEO_H743ZI

config BOARD
	default "nucleo_h743zi"

if NETWORKING

config NET_L2_ETHERNET
	default y

endif # NETWORKING

# flash alignment
config FLASH_ALIGNMENT_WORD_SIZE_BYTES
	int "Size of the flash word"
	default 8
	help
	  Sets the alignment size of a flash word.

endif # BOARD_NUCLEO_H743ZI
```

## drivers/ethernet/Kconfig.dsa
```kconfig
# Distributed Switch Architecture [DSA] configuration options

# Copyright (c) 2020 DENX Software Engineering GmbH
#               Lukasz Majewski <lukma@denx.de>
# SPDX-License-Identifier: Apache-2.0

menuconfig NET_DSA
	bool "Distributed Switch Architecture support"
	depends on NET_L2_ETHERNET
	help
	  Enable Distributed Switch Architecture support.

if NET_DSA

config DSA_KSZ8794
	bool "Enable support for KSZ8794"
	help
	  Add support for KSZ8794 DSA device driver.

config DSA_KSZ8794_TAIL_TAGGING
	bool "Enable support for tail tagging on KSZ8794"
	help
	  Add support for tail tagging on KSZ8794 DSA device.

module = NET_DSA
module-dep = NET_LOG
module-str = Log level for DSA
module-help = Enables core DSA code to output debug messages.
source "subsys/net/Kconfig.template.log_config.net"

endif # NET_DSA
```

## dts/bindings/flash_controller/st,stm32-qspi-nor-ospi.yaml
```yaml
# Copyright (c) 2020, Linaro limited
# SPDX-License-Identifier: Apache-2.0

description: |
    STM32 OSPI Flash controller supporting the JEDEC CFI interface by
    mimicking a QSPI controller.

    Representation of a serial flash on a octospi bus:

      &octospi1 {
        pinctrl-0 = <
              &octospi_clk_pb2
              &octospi_ncs_pg6
              &octospi_bk1_io0_pd11
              &octospi_bk1_io1_pc10
              &octospi_bk1_io2_pe2
              &octospi_bk1_io3_pd13
          >;

          status = "okay";
          clock-port = <1>;
          ncs-port = <1>;
          io-low-port = <0x10001>;
      }

compatible: "st,stm32-qspi-nor-ospi"

include: ["flash-controller.yaml", "jedec,jesd216.yaml"]

on-bus: ospi

properties:
    reg:
      required: true
    qspi-max-frequency:
      type: int
      required: true
      description: Maximum clock frequency of device's QSPI interface in Hz
    label:
      required: true
    size:
      required: true
      description: Flash Memory size in bits
    use-four-datalines:
      type: boolean
      description: |
        Enable Data Read and Writes to utilize the QSPI's
        four data lines. This is disabled by default to
        maintain backwards compatibility.
```

## dts/bindings/ospi/st,stm32-ospi.yaml
```yaml
# Copyright (c) 2020, Nobleo Technology
# SPDX-License-Identifier: Apache-2.0

description: |
    STM32 OSPI device representation. A stm32 octospi node would typically
    looks to this:

      &octospi1 {
        pinctrl-0 = <
          &octospi_clk_pb2
          &octospi_ncs_pg6
          &octospi_bk1_io0_pd11
          &octospi_bk1_io1_pc10
          &octospi_bk1_io2_pe2
          &octospi_bk1_io3_pd13
        >;

        status = "okay";
        clock-port = <1>;
        ncs-port = <1>;
        io-low-port = <1>;
      }

compatible: "st,stm32-ospi"

include: base.yaml

bus: ospi

properties:
    reg:
      required: true

    interrupts:
      required: true

    dmas:
      description: |
        Optional DMA channel specifier. If DMA should be used, specifier should
        hold a phandle reference to the dma controller, the channel number,
        the slot number, channel configuration and finally features.

        For example dmas for TX/RX on QSPI
           dmas = <&dma1 5 5 0x0000 0x03>;

    dma-names:
      description: |
        DMA channel name. If DMA should be used, expected value is "tx_rx".

        For example
           dma-names = "tx_rx";

    pinctrl-0:
      type: phandles
      required: true

    chip-select-boundary:
      type: int
      default: 0
      description: |
        It enables the transaction boundary feature and
        defines the boundary of bytes to release the chip select.
        This parameter can be a value between 0 and 31.

    clock-port:
      type: int
      required: true
      description : |
        It indicates which port of the OSPI IO Manager is used for the CLK pins.
        This parameter can be a value between 1 and 8

    ncs-port:
      type: int
      required: true
      description: |
        It indicates which port of the OSPI IO Manager is used for the NCS pin.
        This parameter can be a value between 1 and 8

    dqs-port:
      type: int
      default: 0
      description: |
        It indicates which port of the OSPI IO Manager is used for the DQS pin.
        This parameter can be a value between 0 and 8, 0 means that signal not used

    io-low-port:
      type: int
      default: 0
      description: |
        It indicates which port of the OSPI IO Manager is used for the IO[3:0] pins.

    io-high-port:
      type: int
      default: 0
      description: |
        It indicates which port of the OSPI IO Manager is used for the IO[7:4] pins.

    req-2-ack-time:
      type: int
      default: 1
      description: |
        It indicates the minimum switching duration (in number of clock cycles) expected
        if some signals are multiplexed in the OSPI IO Manager with the other OSPI.
        This parameter can be a value between 1 and 256
```

## tests/drivers/uart/uart_basic_9bit_api/testcase.yaml
```yaml
common:
  integration_platforms:
    - mps2_an385
    - nucleo_h743zi

tests:
  drivers.uart.9bit:
    tags: drivers
    filter: CONFIG_UART_CONSOLE
    harness: keyboard
  drivers.uart.9bit.poll:
    extra_args: CONF_FILE=prj_poll.conf
    tags: drivers
    filter: CONFIG_UART_CONSOLE
    harness: keyboard
```

## tests/drivers/uart/uart_basic_api/testcase.yaml
```yaml
tests:
  drivers.uart.basic_api:
    tags: drivers uart
    filter: CONFIG_UART_CONSOLE
    harness: keyboard
    integration_platforms:
      - mps2_an385
  drivers.uart.basic_api.wide:
    extra_args:
      - OVERLAY_CONFIG="overlay-wide.conf"
    tags: drivers uart
    filter: CONFIG_UART_CONSOLE and CONFIG_SERIAL_SUPPORT_WIDE_DATA
    harness: keyboard
    integration_platforms:
      - nucleo_h743zi
  drivers.uart.basic_api.poll:
    extra_args: CONF_FILE=prj_poll.conf
    tags: drivers uart
    filter: CONFIG_UART_CONSOLE
    harness: keyboard
    integration_platforms:
      - mps2_an385
  drivers.uart.basic_api.shell:
    extra_args: CONF_FILE=prj_shell.conf
    min_flash: 64
    tags: drivers uart
    filter: CONFIG_UART_CONSOLE
    harness: keyboard
    integration_platforms:
      - mps2_an385
  drivers.uart.basic_api.cdc_acm:
    extra_args: OVERLAY_CONFIG="overlay-usb.conf"
                DTC_OVERLAY_FILE="usb.overlay"
    tags: drivers usb
    filter: CONFIG_UART_CONSOLE
    depends_on: usb_device
    harness: keyboard
```
